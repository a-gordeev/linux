## drivers/dma/avalon-test/Kconfig
```kconfig
# SPDX-License-Identifier: GPL-2.0
#
# Copyright (c) 2019, The Linux Foundation. All rights reserved.
# Author: Alexander Gordeev <a.gordeev.box@gmail.com>
#
# Avalon DMA engine
#
config AVALON_TEST
	select AVALON_DMA
	tristate "Intel Avalon-MM DMA Interface for PCIe test driver"
	help
	  This selects a test driver for Avalon-MM DMA Interface for PCI
```

## drivers/misc/cpu-cache-perf/Kconfig
```kconfig
#
# CPU caches performance measure driver
#

config CPU_CACHE_PERF
	tristate "CPU Cache Performance"
```

## drivers/staging/avalon-dma/Kconfig
```kconfig
# SPDX-License-Identifier: GPL-2.0
#
# Avalon DMA engine
#
# Author: Alexander Gordeev <a.gordeev.box@gmail.com>
#
config AVALON_DMA
	tristate "Avalon DMA engine"
	help
	  This selects a driver for Avalon DMA engine IP block

config AVALON_DMA_TARGET_BASE
	hex "Target device base address"
	default "0x70000000"
	depends on AVALON_DMA

config AVALON_DMA_TARGET_SIZE
	hex "Target device memory size"
	default "0x10000000"
	depends on AVALON_DMA

config AVALON_DMA_CTRL_BASE
	hex "Avalon DMA controllers base"
	default "0x00000000"
	depends on AVALON_DMA

config AVALON_DMA_RD_EP_DST_LO
	hex "Avalon DMA read controller base low"
	default "0x80000000"
	depends on AVALON_DMA

config AVALON_DMA_RD_EP_DST_HI
	hex "Avalon DMA read controller base high"
	default "0x00000000"
	depends on AVALON_DMA

config AVALON_DMA_WR_EP_DST_LO
	hex "Avalon DMA write controller base low"
	default "0x80002000"
	depends on AVALON_DMA

config AVALON_DMA_WR_EP_DST_HI
	hex "Avalon DMA write controller base high"
	default "0x00000000"
	depends on AVALON_DMA
```

## drivers/staging/avalon-drv/Kconfig
```kconfig
# SPDX-License-Identifier: GPL-2.0
#
# Avalon DMA driver
#
# Author: Alexander Gordeev <a.gordeev.box@gmail.com>
#
config AVALON_DRV
	depends on AVALON_DMA
	tristate "Avalon DMA driver"
	help
	  This selects a driver for Avalon DMA

config AVALON_DRV_PCI_VENDOR_ID
	hex "PCI vendor ID"
	default "0x1172"

config AVALON_DRV_PCI_DEVICE_ID
	hex "PCI device ID"
	default "0xe003"

config AVALON_DRV_PCI_BAR
	int "PCI device BAR the Avalon DMA controller is mapped to"
	range 0 5
	default 0

config AVALON_DRV_PCI_MSI_COUNT_ORDER
	int "Count of MSIs the PCI device provides (order)"
	range 0 5
	default 5

config AVALON_DRV_PCI_MSI_VECTOR
	int "MSI vector the Avalon DMA controller uses in multi-MSI mode"
	range 0 31
	default 0
```
